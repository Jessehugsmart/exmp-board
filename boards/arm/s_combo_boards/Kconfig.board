## boards/arm/s_combo_boards/Kconfig.board
```kconfig
# Copyright (c) 2023 Nordic Semiconductor ASA
# SPDX-License-Identifier: Apache-2.0

config BOARD_S_COMBO_BOARDS
	bool "S_Combo_Boards"
	depends on SOC_NRF5340_CPUAPP_QKAA
config BOARD_NRF5340DK_NRF5340_CPUAPP_NS
	bool "nRF5340 DK nRF5340 Application MCU non-secure"


config BOARD_NRF5340DK_NRF5340_CPUNET
	bool "nRF5340 DK NRF5340 Network MCU"
	depends on SOC_NRF5340_CPUNET_QKAA
```

## boards/arm/s_combo_boards/Kconfig.board.bak
```kconfig
# Copyright (c) 2023 Nordic Semiconductor ASA
# SPDX-License-Identifier: Apache-2.0

config BOARD_S_COMBO_BOARDS
	bool "S_Combo_Boards"
	depends on SOC_NRF5340_CPUAPP_QKAA
```

## boards/arm/s_combo_boards/s_combo_boards_defconfig
```kconfig
# Copyright (c) 2023 Nordic Semiconductor ASA
# SPDX-License-Identifier: Apache-2.0
# Enable clock
CONFIG_CLOCK_CONTROL_NRF_K32SRC_SYNTH=y
CONFIG_CLOCK_CONTROL_NRF_K32SRC_RC=y

# Enable CLK + LFXO pins as GPIO 
CONFIG_NFCT_PINS_AS_GPIOS=y
CONFIG_CLOCK_CONTROL_NPCX_EXTERNAL_SRC=n
CONFIG_CLOCK_CONTROL_NRF_CALIBRATION_LF_ALWAYS_ON=n
CONFIG_SOC_ENABLE_LFXO=n 

CONFIG_SOC_SERIES_NRF53X=y
CONFIG_SOC_NRF5340_CPUAPP_QKAA=y
CONFIG_BOARD_S_COMBO_BOARDS=y

# Enable MPU
CONFIG_ARM_MPU=y

# Enable hardware stack protection
CONFIG_HW_STACK_PROTECTION=y

# Enable TrustZone-M
CONFIG_ARM_TRUSTZONE_M=y

# Enable clock
CONFIG_CLOCK_CONTROL_NRF_K32SRC_SYNTH=y
CONFIG_CLOCK_CONTROL_NRF_K32SRC_RC=y

# Enable CLK + LFXO pins as GPIO 
CONFIG_NFCT_PINS_AS_GPIOS=y
CONFIG_CLOCK_CONTROL_NPCX_EXTERNAL_SRC=n
CONFIG_CLOCK_CONTROL_NRF_CALIBRATION_LF_ALWAYS_ON=n
CONFIG_SOC_ENABLE_LFXO=n 
CONFIG_PINCTRL=y
```
